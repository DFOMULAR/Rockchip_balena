## layers/meta-balena-rockpi/conf/machine/rock-4c-plus-rk3399.conf
```bitbake
#@TYPE: Machine
#@NAME: Rock-4c-plus machine
#@DESCRIPTION: Rock-4c-plus development board config file

require conf/machine/include/rockpi-4.inc

#KBUILD_DEFCONFIG = ""
PREFERRED_PROVIDER_virtual/kernel = "linux-rockchip"
#PREFERRED_VERSION_linux-rockchip = "4.4.194-rockchip"

#v5.10
PREFERRED_VERSION_linux-rockchip = "5.10"
KBUILD_DEFCONFIG = "defconfig"

KERNEL_DEVICETREE = "rockchip/rk3399-rock-4c-plus.dtb"
UBOOT_MACHINE = "rock-4c-plus-rk3399_defconfig"

MACHINE_ESSENTIAL_EXTRA_RRECOMMENDS += "\
   brcm-tools \
   rkwifibt-firmware-ap6256-wifi \
   rkwifibt-firmware-ap6256-bt \
   bluetooth-broadcom \
"
#   brcmfmac 
```
